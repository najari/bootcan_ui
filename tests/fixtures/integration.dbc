VERSION "bootCAN integration fixture"
NS_ :

BS_:
BU_: ECU Tester

BO_ 256 Standard: 2 ECU
 SG_ Shared : 0|8@1+ (0.5,-10) [-10|117.5] "V" Tester
 SG_ Signed : 8|8@1- (1,0) [-128|127] "" Tester

BO_ 2147483904 Extended: 2 ECU
 SG_ Shared : 7|16@0+ (1,0) [0|65535] "" Tester

BO_ 512 Multiplexed: 3 ECU
 SG_ Selector M : 0|8@1+ (1,0) [0|255] "" Tester
 SG_ PageOne m1 : 8|8@1+ (1,0) [0|255] "" Tester
 SG_ PageTwo m2 : 8|8@1+ (1,0) [0|255] "" Tester
 SG_ Always : 16|8@1+ (1,0) [0|255] "" Tester

BO_ 513 RangedMux: 2 ECU
 SG_ Selector M : 0|8@1+ (1,0) [0|255] "" Tester
 SG_ Ranged m1 : 8|8@1+ (1,0) [0|255] "" Tester

BO_ 514 FloatValue: 4 ECU
 SG_ Value : 0|32@1+ (1,0) [-100|100] "" Tester

BO_ 515 WideValue: 8 ECU
 SG_ Value : 0|64@1+ (1,0) [0|18446744073709551615] "" Tester

BO_ 516 FdValue: 64 ECU
 SG_ LastByte : 504|8@1+ (1,0) [0|255] "" Tester

VAL_ 256 Shared 2 "StandardOnly";
VAL_ 2147483904 Shared 2 "ExtendedOnly";
SG_MUL_VAL_ 513 Ranged Selector 1-3;
SIG_VALTYPE_ 514 Value : 1;
BA_DEF_ BO_ "VFrameFormat" ENUM "StandardCAN","ExtendedCAN","StandardCAN_FD","ExtendedCAN_FD";
BA_ "VFrameFormat" BO_ 516 2;
